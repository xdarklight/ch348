## Kconfig
```kconfig
config USB_SERIAL_CH348
	tristate "USB Winchiphead CH348 Octo Port Serial Driver"
	help
	  Say Y here if you want to use a Winchiphead CH348 octo port
	  USB to serial adapter.

	  To compile this driver as a module, choose M here: the
	  module will be called ch348.
```
